/*########################   Weather Display  #############################
 * Receives and displays the weather forecast from the Weather Underground and then displays using a 
 * JSON decoder wx data to show weather data on a 4.2" 400x300 pixel SPI bus e-paper display.
 * Weather data received via WiFi connection to Weather Underground Servers and using their 'Forecast' and 'Astronomy' API and data
 * is decoded using the excellent Benoit Blanchon's (c) 2014-2017 JSON library.
 * This source code is protected under the terms of the MIT License and is copyright (c) 2017 by David Bird and permission is hereby granted, free of charge, to
 * any person obtaining a copy of this software and associated documentation files (the "Software"), to deal in the Software
 * without restriction, including without limitation the rights to use, copy, modify, merge, publish, distribute, but not to sub-license and/or 
 * to sell copies of the Software or to permit persons to whom the Software is furnished to do so, subject to the following conditions:
 *   The above copyright notice and this permission notice shall be included in all copies or substantial portions of the Software.
 *   THE SOFTWARE IS PROVIDED "AS IS", WITHOUT WARRANTY OF ANY KIND, EXPRESS OR IMPLIED, INCLUDING BUT NOT LIMITED TO THE WARRANTIES OF MERCHANTABILITY, 
 *   FITNESS FOR A PARTICULAR PURPOSE AND NONINFRINGEMENT. IN NO EVENT SHALL THE AUTHORS OR COPYRIGHT HOLDERS BE LIABLE FOR ANY CLAIM, DAMAGES OR OTHER 
 *   LIABILITY, WHETHER IN AN ACTION OF CONTRACT, TORT OR OTHERWISE, ARISING FROM, OUT OF OR IN CONNECTION WITH THE SOFTWARE OR THE USE OR OTHER DEALINGS IN THE SOFTWARE. 
 *   
 *   See more at http://dsbird.org.uk */
       
#include <ESP8266WiFi.h>
#include <ArduinoJson.h>     // https://github.com/bblanchon/ArduinoJson
#include <WiFiClient.h>
#include "time.h"
#include <SPI.h>
#include <GxEPD.h>
#include <GxGDEW042T2/GxGDEW042T2.cpp>
#include <Fonts/FreeSans9pt7b.h>
#include <GxIO/GxIO_SPI/GxIO_SPI.cpp>
#include <GxIO/GxIO.cpp>

//################# LIBRARIES ##########################
String version = "1.0";       // Version of this program
//################ VARIABLES ###########################

// Define each of the *icons for display
const unsigned char sunny_icon[] = { // 56x48
0xff, 0xff, 0xff, 0xff, 0xff, 0xff, 0xff, 0xff, 0xff, 0xff, 0xff, 0xff, 0xff, 0xff, 0xff, 0xff, 0xff, 0xff, 0xff, 0xff, 0xff, 0xff, 0xff, 0xff, 0xf3, 0xff, 0xff, 0xff, 
0xff, 0xff, 0xff, 0xe1, 0xff, 0xff, 0xff, 0xff, 0xff, 0xff, 0xe1, 0xff, 0xff, 0xff, 0xff, 0xff, 0xff, 0xe1, 0xff, 0xff, 0xff, 0xff, 0xff, 0xff, 0xe1, 0xff, 0xff, 0xff, 
0xff, 0xff, 0xff, 0xe1, 0xff, 0xff, 0xff, 0xff, 0xfc, 0xff, 0xe1, 0xff, 0xff, 0xff, 0xff, 0xf8, 0x7f, 0xe1, 0xff, 0x9f, 0xff, 0xff, 0xf0, 0x7f, 0xf3, 0xff, 0x0f, 0xff, 
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0xff, 0xff, 0xff, 0xf3, 0xff, 0xff, 0xff, 0xff, 0xff, 0xff, 0xff, 0xff, 0xff, 0xff, 0xff, 0xff, 0xff, 0xff, 0xff, 0xff, 0xff, 0xff, 0xff, 0xff, 0xff, 0xff, 0xff, 0xff };

const unsigned char mostlysunny_icon[]  = { // 56x48
0xff, 0xff, 0xff, 0xff, 0xff, 0xff, 0xff, 0xff, 0xff, 0xff, 0xff, 0xff, 0xff, 0xff, 0xff, 0xff, 0xff, 0xff, 0xc7, 0xff, 0xff, 0xff, 0xff, 0xff, 0xff, 0x87, 0xff, 0xff, 
0xff, 0xff, 0xff, 0xff, 0x87, 0xff, 0xff, 0xff, 0xff, 0xff, 0xff, 0x87, 0xff, 0xff, 0xff, 0xff, 0xff, 0xff, 0x87, 0xff, 0xff, 0xff, 0xff, 0xff, 0xff, 0x87, 0xff, 0xff, 
0xff, 0xff, 0xfe, 0xff, 0x87, 0xfe, 0xff, 0xff, 0xff, 0xf8, 0x7f, 0x87, 0xf8, 0x7f, 0xff, 0xff, 0xf8, 0x3f, 0xcf, 0xf0, 0x7f, 0xff, 0xff, 0xfc, 0x1f, 0xff, 0xe0, 0xff, 
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0xe0, 0x00, 0x00, 0x00, 0x03, 0xff, 0xff, 0xf8, 0x00, 0x00, 0x00, 0x0f, 0xff, 0xff, 0xff, 0x00, 0x00, 0x00, 0x7f, 0xff, 0xff, 0xff, 0xff, 0xff, 0xff, 0xff, 0xff, 0xff };

const unsigned char rain_icon[] = { // 56x48
0xff, 0xff, 0xff, 0xff, 0xff, 0xff, 0xff, 0xff, 0xff, 0xff, 0xff, 0xff, 0xff, 0xff, 0xff, 0xff, 0xff, 0xe1, 0xff, 0xff, 0xff, 0xff, 0xff, 0xfc, 0x00, 0x0f, 0xff, 0xff, 
0xff, 0xff, 0xf0, 0x00, 0x03, 0xff, 0xff, 0xff, 0xff, 0xe0, 0x00, 0x03, 0xff, 0xff, 0xff, 0xff, 0x80, 0x7e, 0x01, 0xff, 0xff, 0xff, 0xff, 0x80, 0xff, 0x80, 0xff, 0xff, 
0xff, 0xff, 0x81, 0xff, 0xe0, 0x7f, 0xff, 0xff, 0xff, 0x07, 0xff, 0xf8, 0x3f, 0xff, 0xff, 0xfe, 0x1f, 0xff, 0xfc, 0x07, 0xff, 0xff, 0xfe, 0x3f, 0xff, 0xfc, 0x01, 0xff, 
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0xff, 0xff, 0x07, 0x03, 0xff, 0xff, 0xff, 0xff, 0xff, 0x0f, 0x07, 0xff, 0xff, 0xff, 0xff, 0xff, 0xff, 0x0f, 0xff, 0xff, 0xff, 0xff, 0xff, 0xff, 0xff, 0xff, 0xff, 0xff};

const unsigned char tstorms_icon[] = { // 56x48
0xff, 0xff, 0xff, 0xff, 0xff, 0xff, 0xff, 0xff, 0xff, 0xff, 0xff, 0xff, 0xff, 0xff, 0xff, 0xff, 0xff, 0x00, 0x3f, 0xff, 0xff, 0xff, 0xff, 0xf0, 0x00, 0x03, 0xff, 0xff, 
0xff, 0xff, 0xe0, 0x00, 0x03, 0xff, 0xff, 0xff, 0xff, 0x80, 0x7f, 0x80, 0xff, 0xff, 0xff, 0xff, 0x81, 0xff, 0xe0, 0x7f, 0xff, 0xff, 0xff, 0x83, 0xff, 0xf0, 0x3f, 0xff, 
0xff, 0xff, 0x07, 0xff, 0xfc, 0x1f, 0xff, 0xff, 0xfc, 0x3f, 0xff, 0xfc, 0x00, 0xff, 0xff, 0xf8, 0x3f, 0xff, 0xfe, 0x00, 0x7f, 0xff, 0xf8, 0x7f, 0xff, 0xff, 0x00, 0x3f, 
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0xff, 0xff, 0x87, 0xff, 0x9f, 0xff, 0xff, 0xff, 0xff, 0xef, 0xff, 0xff, 0xff, 0xff, 0xff, 0xff, 0xff, 0xff, 0xff, 0xff, 0xff, 0xff, 0xff, 0xff, 0xff, 0xff, 0xff, 0xff};

const unsigned char cloudy_icon[] = { // 56x48
0xff, 0xff, 0xff, 0xff, 0xff, 0xff, 0xff, 0xff, 0xff, 0xff, 0xff, 0xff, 0xff, 0xff, 0xff, 0xff, 0xff, 0xc1, 0xff, 0xff, 0xff, 0xff, 0xff, 0xf8, 0x00, 0x07, 0xff, 0xff, 
0xff, 0xff, 0xf0, 0x00, 0x03, 0xff, 0xff, 0xff, 0xff, 0xc0, 0x00, 0x03, 0xff, 0xff, 0xff, 0xff, 0x80, 0x3e, 0x01, 0xff, 0xff, 0xff, 0xff, 0x80, 0xff, 0x80, 0xff, 0xff, 
0xff, 0xff, 0x81, 0xff, 0xe0, 0x7f, 0xff, 0xff, 0xff, 0x03, 0xff, 0xf8, 0x3f, 0xff, 0xff, 0xfe, 0x0f, 0xff, 0xfc, 0x07, 0xff, 0xff, 0xfe, 0x1f, 0xff, 0xfc, 0x01, 0xff, 
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0xff, 0xff, 0xff, 0xff, 0xff, 0xff, 0xff, 0xff, 0xff, 0xff, 0xff, 0xff, 0xff, 0xff, 0xff, 0xff, 0xff, 0xff, 0xff, 0xff, 0xff, 0xff, 0xff, 0xff, 0xff, 0xff, 0xff, 0xff};

const unsigned char snow_icon[] = { // 56x48
0xff, 0xff, 0xff, 0xfc, 0x07, 0xff, 0xff, 0xff, 0xff, 0xff, 0xe0, 0x01, 0xff, 0xff, 0xff, 0xff, 0xff, 0x80, 0x00, 0x7f, 0xff, 0xff, 0xff, 0xfe, 0x00, 0xe0, 0x0f, 0xff, 
0xff, 0xff, 0xfc, 0x07, 0xfc, 0x07, 0xff, 0xff, 0xff, 0xe8, 0x1f, 0xfe, 0x07, 0xff, 0xff, 0xff, 0x00, 0x3f, 0xff, 0x07, 0xff, 0xff, 0xfc, 0x00, 0x7f, 0xff, 0x83, 0xff, 
0xff, 0xf0, 0x00, 0xff, 0xff, 0xc3, 0xff, 0xff, 0xc0, 0x7f, 0xff, 0xff, 0xe0, 0xff, 0xff, 0xc0, 0xff, 0xff, 0xff, 0xe0, 0x3f, 0xff, 0xc1, 0xff, 0xff, 0xff, 0xe0, 0x0f, 
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0xff, 0xef, 0xff, 0x00, 0x3f, 0xff, 0xff, 0xff, 0xff, 0xff, 0x71, 0x1f, 0xff, 0xff, 0xff, 0xff, 0xff, 0xf1, 0xff, 0xff, 0xff, 0xff, 0xff, 0xff, 0xf3, 0xff, 0xff, 0xff};

const unsigned char sleet_icon[] = { // 56x48
0xff, 0xff, 0xff, 0xfc, 0x03, 0xff, 0xff, 0xff, 0xff, 0xff, 0xe0, 0x00, 0xff, 0xff, 0xff, 0xff, 0xff, 0x80, 0x00, 0x7f, 0xff, 0xff, 0xff, 0xfe, 0x00, 0xe0, 0x0f, 0xff, 
0xff, 0xff, 0xfc, 0x07, 0xfc, 0x07, 0xff, 0xff, 0xff, 0xe0, 0x1f, 0xfe, 0x07, 0xff, 0xff, 0xff, 0x00, 0x3f, 0xff, 0x07, 0xff, 0xff, 0xfc, 0x00, 0x7f, 0xff, 0x83, 0xff, 
0xff, 0xf0, 0x00, 0x7f, 0xff, 0xc3, 0xff, 0xff, 0xc0, 0x7f, 0xff, 0xff, 0xe0, 0xff, 0xff, 0xc0, 0xff, 0xff, 0xff, 0xe0, 0x1f, 0xff, 0xc1, 0xff, 0xff, 0xff, 0xe0, 0x0f, 
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0xff, 0xff, 0xfc, 0x01, 0xff, 0xff, 0xff, 0xff, 0xff, 0xf8, 0x8e, 0xff, 0xff, 0xff, 0xff, 0xff, 0xff, 0x8f, 0xff, 0xff, 0xff, 0xff, 0xff, 0xff, 0xcf, 0xff, 0xff, 0xff};

const unsigned char fog_icon[] = { // 56x48
0xff, 0xff, 0xff, 0xff, 0xff, 0xff, 0xff, 0xff, 0xff, 0xff, 0xff, 0xff, 0xff, 0xff, 0xff, 0xff, 0xff, 0xff, 0xff, 0xff, 0xff, 0xff, 0xff, 0xff, 0xff, 0xff, 0xff, 0xff, 
0xff, 0xff, 0xff, 0xe0, 0x1f, 0xff, 0xff, 0xff, 0xff, 0xff, 0x00, 0x07, 0xff, 0xff, 0xff, 0xff, 0xfc, 0x00, 0x01, 0xff, 0xff, 0xff, 0xff, 0xf8, 0x1f, 0xe0, 0xff, 0xff, 
0xff, 0xff, 0xf0, 0x7f, 0xf8, 0x7f, 0xff, 0xff, 0xff, 0xc3, 0xff, 0xfe, 0x1f, 0xff, 0xff, 0xff, 0x87, 0xff, 0xff, 0x0f, 0xff, 0xff, 0xff, 0x87, 0xff, 0xff, 0x8f, 0xff, 
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0xff, 0xff, 0xff, 0xff, 0xff, 0xff, 0xff, 0xff, 0xff, 0xff, 0xff, 0xff, 0xff, 0xff, 0xff, 0xff, 0xff, 0xff, 0xff, 0xff, 0xff, 0xff, 0xff, 0xff, 0xff, 0xff, 0xff, 0xff};

const unsigned char nodata_icon[] = { // 56x48
0xff, 0xff, 0xff, 0xff, 0xff, 0xff, 0xff, 0xff, 0xff, 0xff, 0xff, 0xff, 0xff, 0xff, 0xff, 0xff, 0xff, 0xff, 0xff, 0xff, 0xff, 0xff, 0xff, 0xff, 0xff, 0xff, 0xff, 0xff, 
0xff, 0xff, 0xff, 0xff, 0xff, 0xff, 0xff, 0xff, 0xff, 0xff, 0xff, 0xff, 0xff, 0xff, 0xff, 0xff, 0xff, 0xff, 0xff, 0xff, 0xff, 0xff, 0xff, 0xff, 0xff, 0xff, 0xff, 0xff, 
0xff, 0xff, 0xff, 0xff, 0xff, 0xff, 0xff, 0xff, 0xff, 0xff, 0x00, 0x7f, 0xff, 0xff, 0xff, 0xff, 0xff, 0x00, 0x3f, 0xff, 0xff, 0xff, 0xff, 0xfc, 0x00, 0x0f, 0xff, 0xff, 
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0xff, 0xff, 0xff, 0xff, 0xff, 0xff, 0xff, 0xff, 0xff, 0xff, 0xff, 0xff, 0xff, 0xff, 0xff, 0xff, 0xff, 0xff, 0xff, 0xff, 0xff, 0xff, 0xff, 0xff, 0xff, 0xff, 0xff, 0xff};

const unsigned char thermo_icon[] = { // 64x24
0xff, 0xff, 0xff, 0xff, 0xff, 0xff, 0xff, 0xff, 0xfe, 0x7f, 0xff, 0xff, 0xff, 0xff, 0xff, 0xff, 0xfc, 0x3f, 0xff, 0xff, 0xff, 0xff, 0xdf, 0xff, 
0xf9, 0x9f, 0xff, 0xff, 0xff, 0xff, 0xdf, 0xff, 0xfb, 0xdf, 0xff, 0xff, 0xf3, 0xff, 0xdf, 0xff, 0xfb, 0x5f, 0xff, 0xff, 0xe9, 0xff, 0x0f, 0xff, 
0xfb, 0x5f, 0xfc, 0x7f, 0xed, 0xbf, 0x0f, 0xff, 0xfa, 0x5e, 0x18, 0x3f, 0xed, 0x7e, 0x07, 0xff, 0xfb, 0x5e, 0xd9, 0x9f, 0xed, 0x7e, 0x07, 0xff, 
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0xe0, 0x07, 0xff, 0xff, 0xff, 0xff, 0xfe, 0x07, 0xf0, 0x0f, 0xff, 0xff, 0xff, 0xff, 0xff, 0x07, 0xf8, 0x1f, 0xff, 0xff, 0xff, 0xff, 0xff, 0x8f };

const unsigned char probrain_icon[] = { // 32x24
0xff, 0xff, 0xff, 0xff, 0xff, 0xff, 0xff, 0xff, 0xff, 0xff, 0xff, 0xff, 0xff, 0xf8, 0x1f, 0xff, 0xff, 0xe0, 0x07, 0xff, 0xff, 0xc7, 0xe0, 0x7f, 
0xff, 0xdf, 0xf8, 0x3f, 0xff, 0x1f, 0xff, 0x9f, 0xfc, 0x3f, 0xff, 0xcf, 0xe0, 0x7f, 0xdf, 0xc7, 0xc0, 0xff, 0x9f, 0xc3, 0x9f, 0xff, 0x1f, 0xf9, 
0x3f, 0xff, 0x1f, 0xfc, 0x3f, 0xfe, 0x1f, 0xfc, 0x3f, 0xfb, 0x1f, 0xfc, 0x9f, 0xf3, 0x3b, 0xf9, 0xc0, 0x63, 0xf3, 0x03, 0xe0, 0x63, 0xe3, 0x87, 
0xff, 0xc3, 0xe3, 0xff, 0xff, 0xe7, 0xc3, 0xff, 0xff, 0xe7, 0xe3, 0xff, 0xff, 0xff, 0xe7, 0xff, 0xff, 0xff, 0xff, 0xff, 0xff, 0xff, 0xff, 0xff };

// pins_arduino.h, e.g. WEMOS D1 Mini
//static const uint8_t SS    = D8;
//static const uint8_t MOSI  = D7;
//static const uint8_t MISO  = ;
//static const uint8_t SCK   = D5;
// GxIO_SPI(SPIClass& spi, int8_t cs, int8_t dc, int8_t rst = -1, int8_t bl = -1);
GxIO_Class io(SPI, D8, D3, D4); 
// GxGDEP015OC1(GxIO& io, uint8_t rst = D4, uint8_t busy = D2);
GxEPD_Class display(io, D4, D6); 

//------ NETWORK VARIABLES---------
// Use your own API key by signing up for a free developer account at http://www.wunderground.com/weather/api/
String API_key       = "2--------------7";            // See: http://www.wunderground.com/weather/api/d/docs (change here with your KEY)
String City          = "Melksham";                     // Your home city
String Country       = "UK";                          // Your country   
String Conditions    = "conditions";                  // See: http://www.wunderground.com/weather/api/d/docs?d=data/index&MR=1
char   wxserver[]    = "api.wunderground.com";        // Address for WeatherUnderGround
unsigned long        lastConnectionTime = 0;          // Last time you connected to the server, in milliseconds
const unsigned long  postingInterval    = 10L*60L*1000L; // Delay between updates, in milliseconds, WU allows 500 requests per-day maximum, set to every 10-mins or 144/day
String Units      =  "X"; // M for Metric, X for Mixed and I for Imperial

//################ PROGRAM VARIABLES and OBJECTS ################
// Conditions
String WDay0, Day0, Icon0, High0, Low0, Conditions0, Pop0, Averagehumidity0,
       WDay1, Day1, Icon1, High1, Low1, Conditions1, Pop1, Averagehumidity1,
       WDay2, Day2, Icon2, High2, Low2, Conditions2, Pop2, Averagehumidity2,
       WDay3, Day3, Icon3, High3, Low3, Conditions3, Pop3, Averagehumidity3;
 

// Astronomy
String  DphaseofMoon, Sunrise, Sunset, Moonrise, Moonset, Moonlight;

const char* ssid     = "pourSSID";
const char* password = "yourPASSWORD";
const char* host     = "api.wunderground.com";

String currCondString; // string to hold received API weather data

WiFiClient client; // wifi client object

void setup() { 
  Serial.begin(115200);
  display.init();
  display.fillScreen(GxEPD_WHITE);
  display.setTextColor(GxEPD_BLACK);
  display.setFont(&FreeSans9pt7b);
  display.setCursor(0, 12);
  display.setRotation(2);
  display.println("David Bird (C) 2017\n\rStarting...\n\rReading and Decoding Wx Data...");
  display.update();
  delay(500);
  StartWiFi(ssid,password);
  SetupTime();
  time_t now = time(nullptr);
  Serial.println(ctime(&now));
  lastConnectionTime = millis();
  obtain_forecast("forecast");
  obtain_forecast("astronomy");
  DisplayForecast();
  ESP.deepSleep(10*60*1000000, WAKE_RF_DEFAULT); // Sleep for 10 minutes
}

void loop() {
  if (millis() - lastConnectionTime > postingInterval) {
    obtain_forecast("forecast");
    obtain_forecast("astronomy");
    lastConnectionTime = millis();
    DisplayForecast();
  }
}
void DisplayForecast(){ // Display is 400x300 resolution
  display.fillScreen(GxEPD_WHITE);
  display.setCursor(0,12);
  DisplayWXicon(0,0, Icon0);  DisplayWXicon(75,0, "thermo"); DisplayWXicon(155,0, "probrain");
  display.setCursor(200,15);  display.println(WDay0 + " " + Day0);
  display.setCursor(195,30);  display.println(Conditions0);
  display.setCursor(60,40);   display.println(High0 + "/" + Low0);
  display.setCursor(115,40);  display.println(Averagehumidity0 + "%");
  display.setCursor(158,40);  display.println(Pop0 + "%");
  display.setCursor(60,55);   display.println("--------------------------");
  DisplayWXicon(0,60, Icon1); DisplayWXicon(75,60, "thermo"); DisplayWXicon(155,60, "probrain");
  display.setCursor(200,75);  display.println(WDay1 + " " + Day1);
  display.setCursor(195,90);  display.println(Conditions1);
  display.setCursor(60,100);  display.println(High1 + "/" + Low1);
  display.setCursor(115,100); display.println(Averagehumidity1 + "%");
  display.setCursor(158,100); display.println(Pop1 + "%");
  display.setCursor(60,115);  display.println("-------------------------");
  DisplayWXicon(0,120, Icon2); DisplayWXicon(75,120, "thermo"); DisplayWXicon(155,120, "probrain");
  display.setCursor(200,135); display.println(WDay2 + " " + Day2);
  display.setCursor(195,150); display.println(Conditions2);
  display.setCursor(60,160);  display.println(High2 + "/" + Low2);
  display.setCursor(115,160); display.println(Averagehumidity2 + "%");
  display.setCursor(158,160); display.println(Pop2 + "%");
  display.setCursor(60,175);  display.println("--------------------------");
  DisplayWXicon(0,180, Icon3); DisplayWXicon(75,180, "thermo"); DisplayWXicon(155,180, "probrain");
  display.setCursor(200,195); display.println(WDay3 + " " + Day3);
  display.setCursor(195,210); display.println(Conditions3);
  display.setCursor(60,220);  display.println(High3 + "/" + Low3);
  display.setCursor(115,220); display.println(Averagehumidity3 + "%");
  display.setCursor(158,220); display.println(Pop3 + "%");
  display.setCursor(60,235);  display.println("--------------------------");
  
  display.setCursor(000,245); display.println("Sunrise/Set");
  display.setCursor(000,262); display.println(Sunrise+"/"+Sunset);
  display.setCursor(110,245); display.println("Moonrise/Set");
  display.setCursor(110,262); display.println(Moonrise+"/"+Moonset);
  display.setCursor(225,245); display.println("Moonphase");
  display.setCursor(225,262); display.println(DphaseofMoon+" "+Moonlight+"%");
  time_t now = time(nullptr); display.setCursor(85,292);  display.println(ctime(&now));
 
  display.update(); 
}

void DisplayWXicon(int x, int y, String IconName){
  Serial.println(IconName);
  if      (IconName == "rain"            || IconName == "nt_rain"         ||
           IconName == "chancerain"      || IconName == "nt_chancerain")
           display.drawBitmap(x,y, rain_icon, 56,48, GxEPD_BLACK);
  else if (IconName == "snow"            || IconName == "nt_snow"         ||
           IconName == "flurries"        || IconName == "nt_flurries"     ||
           IconName == "chancesnow"      || IconName == "nt_chancesnow"   ||
           IconName == "chanceflurries"  || IconName == "nt_chanceflurries")
           display.drawBitmap(x,y, snow_icon, 56,48, GxEPD_BLACK);
  else if (IconName == "sleet"           || IconName == "nt_sleet"        ||
           IconName == "chancesleet"     || IconName == "nt_chancesleet")
           display.drawBitmap(x,y, sleet_icon, 56,48, GxEPD_BLACK);
  else if (IconName == "sunny"           || IconName == "nt_sunny"        ||
           IconName == "clear"           || IconName == "nt_clear")
           display.drawBitmap(x,y, sunny_icon, 56,48, GxEPD_BLACK);
  else if (IconName == "partlysunny"     || IconName == "nt_partlysunny"  ||
           IconName == "mostlysunny"     || IconName == "nt_mostlysunny")
           display.drawBitmap(x,y, mostlysunny_icon, 56,48, GxEPD_BLACK);
  else if (IconName == "cloudy"          || IconName == "nt_cloudy"       ||
           IconName == "mostlycloudy"    || IconName == "nt_mostlycloudy" ||
           IconName == "partlycloudy"    || IconName == "nt_partlycloudy")  
           display.drawBitmap(x,y, cloudy_icon, 56,48, GxEPD_BLACK);
  else if (IconName == "tstorms"         || IconName == "nt_tstorms"      ||
           IconName == "chancetstorms"   || IconName == "nt_chancetstorms")
           display.drawBitmap(x,y, tstorms_icon, 56,48, GxEPD_BLACK);
  else if (IconName == "fog"             || IconName == "nt_fog"          ||
           IconName == "hazy"            || IconName == "nt_hazy")
           display.drawBitmap(x,y, fog_icon, 56,48, GxEPD_BLACK);
  else if (IconName == "thermo")
           display.drawBitmap(x,y, thermo_icon,64,24, GxEPD_BLACK);
  else if (IconName == "probrain")
           display.drawBitmap(x,y, probrain_icon,32,24, GxEPD_BLACK);
  else     display.drawBitmap(x,y,nodata_icon, 56,48, GxEPD_BLACK);
}

void obtain_forecast (String forecast_type) {
  static char RxBuf[8704];
  String request;
  request  = "GET /api/" + API_key + "/"+ forecast_type + "/q/" + Country + "/" + City + ".json HTTP/1.1\r\n";
  request += F("User-Agent: Weather Webserver v");
  request += version;
  request += F("\r\n");
  request += F("Accept: */*\r\n");
  request += "Host: " + String(wxserver) + "\r\n";
  request += F("Connection: close\r\n");
  request += F("\r\n");
  Serial.println(request);
  Serial.print(F("Connecting to ")); Serial.println(wxserver);
  WiFiClient httpclient;
  if (!httpclient.connect(wxserver, 80)) {
    Serial.println(F("connection failed"));
    httpclient.flush();
    httpclient.stop();
    return;
  }
  Serial.print(request);
  httpclient.print(request); //send the http request to the server
  httpclient.flush();
  // Collect http response headers and content from Weather Underground, discarding HTTP headers, the content is JSON formatted and will be returned in RxBuf.
  uint16_t respLen = 0;
  bool     skip_headers = true;
  String   rx_line;
  while (httpclient.connected() || httpclient.available()) {
    if (skip_headers) {
      rx_line = httpclient.readStringUntil('\n'); //Serial.println(rx_line);
      if (rx_line.length() <= 1) { // a blank line denotes end of headers
        skip_headers = false;
      }
    }
    else {
      int bytesIn;
      bytesIn = httpclient.read((uint8_t *)&RxBuf[respLen], sizeof(RxBuf) - respLen);
      //Serial.print(F("bytesIn ")); Serial.println(bytesIn);
      if (bytesIn > 0) {
        respLen += bytesIn;
        if (respLen > sizeof(RxBuf)) respLen = sizeof(RxBuf);
      }
      else if (bytesIn < 0) {
        Serial.print(F("read error "));
        Serial.println(bytesIn);
      }
    }
    delay(1);
  }
  httpclient.stop();

  if (respLen >= sizeof(RxBuf)) {
    Serial.print(F("RxBuf overflow "));
    Serial.println(respLen);
    delay(1000);
    return;
  }
  RxBuf[respLen++] = '\0'; // Terminate the C string
  Serial.print(F("respLen ")); Serial.println(respLen); Serial.println(RxBuf);
  if (forecast_type == "forecast"){
    showWeather_forecast(RxBuf); 
  }
  if (forecast_type == "astronomy"){
    showWeather_astronomy(RxBuf); 
  }
}

bool showWeather_astronomy(char *json) {
  StaticJsonBuffer<1*1024> jsonBuffer;
  char *jsonstart = strchr(json, '{'); // Skip characters until first '{' found
  //Serial.print(F("jsonstart ")); Serial.println(jsonstart);
  if (jsonstart == NULL) {
    Serial.println(F("JSON data missing"));
    return false;
  }
  json = jsonstart;
  // Parse JSON
  JsonObject& root = jsonBuffer.parseObject(json);
  if (!root.success()) {
    Serial.println(F("jsonBuffer.parseObject() failed"));
    return false;
  }
  // Extract weather info from parsed JSON
  JsonObject& current = root["moon_phase"];
  String percentIlluminated = current["percentIlluminated"];
  String phaseofMoon = current["phaseofMoon"];
  int SRhour         = current["sunrise"]["hour"];
  int SRminute       = current["sunrise"]["minute"];
  int SShour         = current["sunset"]["hour"];
  int SSminute       = current["sunset"]["minute"];
  int MRhour         = current["moonrise"]["hour"];
  int MRminute       = current["moonrise"]["minute"];
  int MShour         = current["moonset"]["hour"];
  int MSminute       = current["moonset"]["minute"];
  Sunrise   = (SRhour<10?"0":"")+String(SRhour)+":"+(SRminute<10?"0":"")+String(SRminute);
  Sunset    = (SShour<10?"0":"")+String(SShour)+":"+(SSminute<10?"0":"")+String(SSminute);
  Moonrise  = (MRhour<10?"0":"")+String(MRhour)+":"+(MRminute<10?"0":"")+String(MRminute);
  Moonset   = (MShour<10?"0":"")+String(MShour)+":"+(MSminute<10?"0":"")+String(MSminute);
  Moonlight = percentIlluminated;
  DphaseofMoon = phaseofMoon;
  return true;
}

bool showWeather_forecast(char *json) {
  DynamicJsonBuffer jsonBuffer(8704);
  char *jsonstart = strchr(json, '{');
  Serial.print(F("jsonstart ")); Serial.println(jsonstart);
  if (jsonstart == NULL) {
    Serial.println(F("JSON data missing"));
    return false;
  }
  json = jsonstart;

  // Parse JSON
  JsonObject& root = jsonBuffer.parseObject(json);
  if (!root.success()) {
    Serial.println(F("jsonBuffer.parseObject() failed"));
    return false;
  }

  JsonObject& forecast = root["forecast"]["simpleforecast"];
  String wday0  = forecast["forecastday"][0]["date"]["weekday_short"];  WDay0 = wday0;
  int    day0   = forecast["forecastday"][0]["date"]["day"]; day0<10?(Day0="0"+String(day0)):(Day0=String(day0));
  String mon0   = forecast["forecastday"][0]["date"]["monthname_short"];
  String year0  = forecast["forecastday"][0]["date"]["year"];           Day0 += "-" + mon0 + "-" + year0.substring(2); 
  String icon0  = forecast["forecastday"][0]["icon"];                   Icon0 = icon0;
  String high0  = forecast["forecastday"][0]["high"]["celsius"];        High0 = high0;
  String low0   = forecast["forecastday"][0]["low"]["celsius"];         Low0  = low0;
  String conditions0 = forecast["forecastday"][0]["conditions"];        Conditions0  = conditions0;
  String pop0        = forecast["forecastday"][0]["pop"];               Pop0  = pop0;
  String averagehumidity0 = forecast["forecastday"][0]["avehumidity"];  Averagehumidity0 = averagehumidity0;

  String wday1  = forecast["forecastday"][1]["date"]["weekday_short"];  WDay1 = wday1;
  int    day1   = forecast["forecastday"][1]["date"]["day"]; day1<10?(Day1="0"+String(day1)):(Day1=String(day1));
  String mon1   = forecast["forecastday"][1]["date"]["monthname_short"];
  String year1  = forecast["forecastday"][1]["date"]["year"];           Day1 += "-" + mon1 + "-" + year1.substring(2); 
  String icon1  = forecast["forecastday"][1]["icon"];                   Icon1 = icon1;
  String high1  = forecast["forecastday"][1]["high"]["celsius"];        High1 = high1;
  String low1   = forecast["forecastday"][1]["low"]["celsius"];         Low1  = low1;
  String conditions1 = forecast["forecastday"][1]["conditions"];        Conditions1  = conditions1;
  String pop1   = forecast["forecastday"][1]["pop"];                    Pop1  = pop1;
  String averagehumidity1 = forecast["forecastday"][1]["avehumidity"];  Averagehumidity1 = averagehumidity1;
  
  String wday2  = forecast["forecastday"][2]["date"]["weekday_short"];  WDay2 = wday2;
  int    day2   = forecast["forecastday"][2]["date"]["day"]; day2<10?(Day2="0"+String(day2)):(Day2=String(day2));
  String mon2   = forecast["forecastday"][2]["date"]["monthname_short"];
  String year2  = forecast["forecastday"][2]["date"]["year"];           Day2 += "-" + mon2 + "-" + year2.substring(2); 
  String icon2  = forecast["forecastday"][2]["icon"];                   Icon2 = icon2;
  String high2  = forecast["forecastday"][2]["high"]["celsius"];        High2 = high2;
  String low2   = forecast["forecastday"][2]["low"]["celsius"];         Low2  = low2;
  String conditions2 = forecast["forecastday"][2]["conditions"];        Conditions2  = conditions2;
  String pop2   = forecast["forecastday"][2]["pop"];                    Pop2  = pop2;
  String averagehumidity2 = forecast["forecastday"][2]["avehumidity"];  Averagehumidity2 = averagehumidity2;

  String wday3  = forecast["forecastday"][3]["date"]["weekday_short"];  WDay3 = wday3;
  int    day3   = forecast["forecastday"][3]["date"]["day"]; day3<10?(Day3="0"+String(day3)):(Day3=String(day3));
  String mon3   = forecast["forecastday"][3]["date"]["monthname_short"];
  String year3  = forecast["forecastday"][3]["date"]["year"];           Day3 += "-" + mon3 + "-" + year3.substring(2); 
  String icon3  = forecast["forecastday"][3]["icon"];                   Icon3 = icon3;
  String high3  = forecast["forecastday"][3]["high"]["celsius"];        High3 = high3;
  String low3   = forecast["forecastday"][3]["low"]["celsius"];         Low3  = low3;
  String conditions3 = forecast["forecastday"][3]["conditions"];        Conditions3  = conditions3;
  String pop3   = forecast["forecastday"][3]["pop"];                    Pop3  = pop3;
  String averagehumidity3 = forecast["forecastday"][3]["avehumidity"];  Averagehumidity3 = averagehumidity3;

  return true;
}

int StartWiFi(const char* ssid, const char* password){
 int connAttempts = 0;
 Serial.println("\r\nConnecting to: "+String(ssid));
 WiFi.begin(ssid, password);
 while (WiFi.status() != WL_CONNECTED ) {
   delay(500); Serial.print(".");
   if(connAttempts > 20) return -5;
   connAttempts++;
 }
 Serial.println("WiFi connected\r\nIP address: ");
 Serial.println(WiFi.localIP());
 return 1;
}

void clear_screen() {
   display.fillScreen(GxEPD_WHITE);
   display.update();
}  

void SetupTime(){
  configTime(1 * 3600, 0, "pool.ntp.org", "time.nist.gov");
  Serial.println("\nWaiting for time");
  while (!time(nullptr)) {
    delay(500);
  }
}



